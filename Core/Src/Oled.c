/*
 * Oled.c
 *
 *  Created on: Apr 2, 2026
 *      Author: havandat
 */
#include "Oled.h"
#include "cmsis_os.h"


// Font 12x16 của bạn (Giữ nguyên cấu trúc bạn đã cung cấp)
static const uint16_t fond12x16[] = {
    0x0000,0x7efc,0xbc7a,0xc006,0xc006,0xc006,0xc006,0xc006,0xc006,0xbc7a,0x7efc,0x0000, // 0
    0x0000,0x0000,0x0000,0x0000,0x0000,0x0000,0x0000,0x0000,0x0000,0x3c78,0x7efc,0x0000, // 1
    0x0000,0x7e00,0xbd02,0xc386,0xc386,0xc386,0xc386,0xc386,0xc386,0x817a,0x00fc,0x0000, // 2
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    0x0000,0x00fc,0x817a,0xc386,0xc386,0xc386,0xc386,0xc386,0xc386,0xbd7a,0x7efc,0x0000, // 9
    // A-Z
    0x0000,0x0000,0x3000,0x0e00,0x05e0,0x0410,0x05e0,0x0e00,0x3000,0x0000,0x0000,0x0000, // A
    0x0000,0x0000,0x0000,0x3ff0,0x2110,0x2110,0x2110,0x2110,0x3310,0x1ee0,0x0000,0x0000, // B
    0x0000,0x0000,0x0000,0x0fc0,0x1020,0x2010,0x2010,0x2010,0x2010,0x1020,0x0000,0x0000, // C
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    0x0000,0x0000,0x0000,0x0000,0x0000,0x3000,0x3000,0x3000,0x0000,0x0000,0x0000,0x0000 // Chấm (.)
};

// Font 5x7: Rộng 5 cột, cao 8 bit (tương đương 1 page)
static const uint8_t font5x7[] = {
    0x00, 0x00, 0x00, 0x00, 0x00, // Space (Mã ASCII 32)
    0x00, 0x00, 0x5f, 0x00, 0x00, // !
    0x00, 0x07, 0x00, 0x07, 0x00, // "
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    0x00, 0x00, 0x00, 0x00, 0x00  // Khoảng đệm cuối
};

// ============================================================================
// 2. CÁC HÀM ĐIỀU KHIỂN CƠ BẢN
// ============================================================================

void I2C_write_lenh(uint8_t lenh) {
    uint8_t ma_lenh[2] = {0x00, lenh};
    gui_du_lieu(AdOled, ma_lenh, 2);
}

void I2C_write_dulieu(uint8_t du_lieu) {
    uint8_t ma_du_lieu[2] = {0x40, du_lieu};
    gui_du_lieu(AdOled, ma_du_lieu, 2);
}

void OLED_init(void) {
    osDelay(100);
    I2C_write_lenh(0xAE); // Display OFF
        I2C_write_lenh(0x20); // Memory addressing mode
        I2C_write_lenh(0x10); // Page mode
        I2C_write_lenh(0xB0); // Page 0
        I2C_write_lenh(0xC8);
        I2C_write_lenh(0x00);
        I2C_write_lenh(0x10);
        I2C_write_lenh(0x40);
        I2C_write_lenh(0x81); I2C_write_lenh(0x7F);
        I2C_write_lenh(0xA1);
        I2C_write_lenh(0xA6);
        I2C_write_lenh(0xA8); I2C_write_lenh(0x3F);
        I2C_write_lenh(0xA4);
        I2C_write_lenh(0xD3); I2C_write_lenh(0x00);
        I2C_write_lenh(0xD5); I2C_write_lenh(0x80);
        I2C_write_lenh(0xD9); I2C_write_lenh(0xF1);
        I2C_write_lenh(0xDA); I2C_write_lenh(0x12);
        I2C_write_lenh(0xDB); I2C_write_lenh(0x40);
        I2C_write_lenh(0x8D); I2C_write_lenh(0x14);
        I2C_write_lenh(0xAF); // Display ON
}

void Clear_all(void) {
    for (int page = 0; page < 8; page++) {
        I2C_write_lenh(0xB0 + page);
        I2C_write_lenh(0x00);
        I2C_write_lenh(0x10);
        for (int i = 0; i < 130; i++) {
            I2C_write_dulieu(0x00);
        }
    }
}

void Clear_page(void) {
    // Chỉ xóa phần dưới (Page 4 đến 7) để giữ lại đồng hồ phía trên
    for (int page = 4; page < 8; page++) {
        I2C_write_lenh(0xB0 + page);
        I2C_write_lenh(0x00);
        I2C_write_lenh(0x10);
        for (int i = 0; i < 130; i++) {
            I2C_write_dulieu(0x00);
        }
    }
}

void pos(int page, int column) {
    I2C_write_lenh(0xB0 + page);
    I2C_write_lenh(0x10 | (column >> 4));
    I2C_write_lenh(column & 0x0f);
}

// ============================================================================
// 3. CÁC HÀM CHO FONT LỚN 12x16 (Dùng 2 Pages)
// ============================================================================

// Đã bỏ tham số *fond truyền vào, tự động lấy fond12x16 nội bộ
void poit_1(int page, int column, char ky_tu) {
    if (ky_tu == ' ') {
        pos(page, column);
        for(int i = 0; i < 12; i++) I2C_write_dulieu(0x00);
        pos(page + 1, column);
        for(int i = 0; i < 12; i++) I2C_write_dulieu(0x00);
        return;
    }

    uint16_t index = 0;
    if (ky_tu >= '0' && ky_tu <= '9') {
        index = (ky_tu - '0') * 12;  // mỗi ký tự có 12 cột
    }
    else if (ky_tu >= 'A' && ky_tu <= 'Z') {
        index = ((ky_tu - '0') - 7) * 12;
    }
    else if (ky_tu == '.') {
        index = (('0' - ky_tu) + 34) * 12;
    }
    else if (ky_tu == ':') {
        index = (('0' - '.') + 34) * 12; // Tạm mượn dấu chấm cho dấu 2 chấm
    }
    else return;

    // PAGE TRÊN (8 dòng đầu)
    pos(page, column);
    for(int i = 0; i < 12; i++) {
        uint16_t data = fond12x16[index + i];
        I2C_write_dulieu(data & 0x00FF);
    }

    // PAGE DƯỚI (8 dòng sau)
    pos(page + 1, column);
    for(int i = 0; i < 12; i++) {
        uint16_t data = fond12x16[index + i];
        I2C_write_dulieu(data >> 8);      // byte cao
    }
}

// Đã bỏ tham số *fond
void point_many(int page, int column, char* str) {
    while (*str) {
        poit_1(page, column, *str);
        column += 12;    // mỗi ký tự rộng 12 cột
        str++;
    }
}

// ============================================================================
// 4. CÁC HÀM CHO FONT NHỎ 5x7 (Dùng 1 Page)
// ============================================================================

void oled_write_5x7(int page, int column, char ky_tu) {
    // Nếu là ký tự không in được hoặc ngoài bảng, đưa về Space
    if (ky_tu < 32 || ky_tu > 126) ky_tu = ' ';

    // Tính toán index trong mảng 1 chiều (mỗi chữ chiếm 5 byte)
    uint16_t index = (ky_tu - 32) * 5;

    pos(page, column);
    for(int i = 0; i < 5; i++) {
        I2C_write_dulieu(font5x7[index + i]);
    }
    // Cột khoảng cách giữa các chữ
    I2C_write_dulieu(0x00);
}

void oled_string_5x7(int page, int column, char* str) {
    while (*str) {
        oled_write_5x7(page, column, *str);
        column += 6; // 5 cột font + 1 cột khoảng cách trắng
        str++;

        // Nếu tràn viền màn hình (128 cột), tự động ngắt
        if(column > 122) break;
    }
}
